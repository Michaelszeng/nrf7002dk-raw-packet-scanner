## prj.conf
```kconfig
#
# Copyright (c) 2022 Nordic Semiconductor ASA
#
# SPDX-License-Identifier: LicenseRef-Nordic-5-Clause
#
CONFIG_WIFI=y
CONFIG_WIFI_NRF700X=y
CONFIG_NET_L2_WIFI_MGMT=y
CONFIG_HEAP_MEM_POOL_SIZE=25000

# System settings
CONFIG_NEWLIB_LIBC=y

# Networking
CONFIG_NETWORKING=y
CONFIG_NET_L2_ETHERNET=y
CONFIG_NET_NATIVE=n
CONFIG_NET_OFFLOAD=y

CONFIG_INIT_STACKS=y

# Memories
CONFIG_MAIN_STACK_SIZE=2048

# Debugging
CONFIG_STACK_SENTINEL=y
CONFIG_DEBUG_COREDUMP=y
CONFIG_DEBUG_COREDUMP_BACKEND_LOGGING=y
CONFIG_DEBUG_COREDUMP_MEMORY_DUMP_MIN=y

# Logging
CONFIG_LOG=y
CONFIG_PRINTK=y
# CONFIG_LOG_MODE_MINIMAL=y
CONFIG_USE_SEGGER_RTT=y
CONFIG_SEGGER_RTT_BUFFER_SIZE_UP=4096

# printing of scan results puts pressure on queues in new locking
# design in net_mgmt. So, use a higher timeout for a crowded
# environment.
CONFIG_NET_MGMT_EVENT_QUEUE_TIMEOUT=5000

# Vendor Specfic IE
CONFIG_WIFI_MGMT_RAW_SCAN_RESULTS=y
```

## src/enums.h
```c
enum ID_TYPE {
	ID_NONE = 0, 
	SERIAL_NUMBER_ANSI_CTA_2063_A = 1, 
	CAA_ASSIGNED_REGISTRATION_ID = 2, 
	UTM_ASSIGNED_UUID = 3, 
	SPECIFIC_SESSION_ID = 4
};
static const char* const ID_TYPE_STRING[] = {
	[ID_NONE] = "ID_NONE",
	[SERIAL_NUMBER_ANSI_CTA_2063_A] = "SERIAL_NUMBER_ANSI_CTA_2063_A",
	[CAA_ASSIGNED_REGISTRATION_ID] = "CAA_ASSIGNED_REGISTRATION_ID",
	[UTM_ASSIGNED_UUID] = "UTM_ASSIGNED_UUID",
	[SPECIFIC_SESSION_ID] = "SPECIFIC_SESSION_ID"
};

enum UA_TYPE {
	UA_NONE = 0, 
	AEROPLANE = 1, 
	HELICOPTER_MULTIROTOR = 2, 
	GYROPLANE = 3, 
	HYBRID_LIFT = 4, 
	ORNITHOPTOR = 5, 
	GLIDER = 6, 
	KITE = 7, 
	FREE_BALLOON = 8, 
	CAPTIVE_BALLOON = 9, 
	AIRSHIP = 10, 
	FREE_FALL_PARACHUTE = 11, 
	ROCKET = 12, 
	TETHERED_POWERED_AIRCRAFT = 13, 
	GROUND_OBSTACLE = 14, 
	OTHER = 15
};
static const char* const UA_TYPE_STRING[] = {
	[UA_NONE] = "UA_NONE",
	[AEROPLANE] = "AEROPLANE",
	[HELICOPTER_MULTIROTOR] = "HELICOPTER_MULTIROTOR",
	[GYROPLANE] = "GYROPLANE",
	[HYBRID_LIFT] = "HYBRID_LIFT",
	[ORNITHOPTOR] = "ORNITHOPTOR",
	[GLIDER] = "GLIDER",
	[KITE] = "KITE",
	[FREE_BALLOON] = "FREE_BALLOON",
	[CAPTIVE_BALLOON] = "CAPTIVE_BALLOON",
	[AIRSHIP] = "AIRSHIP",
	[FREE_FALL_PARACHUTE] = "FREE_FALL_PARACHUTE",
	[ROCKET] = "ROCKET",
	[TETHERED_POWERED_AIRCRAFT] = "TETHERED_POWERED_AIRCRAFT",
	[GROUND_OBSTACLE] = "GROUND_OBSTACLE",
	[OTHER] = "OTHER"
};

enum OPERATIONAL_STATUS {
	UNDECLARED = 0, 
	GROUND = 1, 
	AIRBORNE = 2, 
	EMERGENCY = 3, 
	REMOTE_ID_SYSTEM_FAILURE = 4
};
static const char* const OPERATIONAL_STATUS_STRING[] = {
	[UNDECLARED] = "UNDECLARED",
	[GROUND] = "GROUND",
	[AIRBORNE] = "AIRBORNE",
	[EMERGENCY] = "EMERGENCY",
	[REMOTE_ID_SYSTEM_FAILURE] = "REMOTE_ID_SYSTEM_FAILURE"
};


enum HEIGHT_TYPE {
	ABOVE_TAKEOFF = 0,
	AGL = 1
};
static const char* const HEIGHT_TYPE_STRING[] = {
	[ABOVE_TAKEOFF] = "ABOVE_TAKEOFF",
	[AGL] = "AGL"  // Above Ground Level
};

enum E_W_DIRECTION_SEGMENT {
	LESS_THAN_180 = 0,
	GREATER_THAN_EQUAL_TO_180 = 1
};
static const char* const E_W_DIRECTION_SEGMENT_STRING[] = {
	[LESS_THAN_180] = "<180",
	[GREATER_THAN_EQUAL_TO_180] = ">=180"
};

enum SPEED_MULTIPLIER {
	X_0_25 = 0,
	X_0_75 = 1
};
static const char* const SPEED_MULTIPLIER_STRING[] = {
	[X_0_25] = "0.25",
	[X_0_75] = "0.75"
};

enum VERTICAL_HORIZONTAL_BARO_ALT_ACCURACY {
	UNKNOWN_GREATER_THAN_150M = 0, 
	LESS_THAN_150M = 1, 
	LESS_THAN_45M = 2, 
	LESS_THAN_25M = 3, 
	LESS_THAN_10M = 4,
	LESS_THAN_3M = 5,
	LESS_THAN_1M = 6
};
static const char* const VERTICAL_HORIZONTAL_BARO_ALT_ACCURACY_STRING[] = {
	[UNKNOWN_GREATER_THAN_150M] = "UNKNOWN OR >=150 m",
	[LESS_THAN_150M] = "<150 m",
	[LESS_THAN_45M] = "<45 m",
	[LESS_THAN_25M] = "<25 m",
	[LESS_THAN_10M] = "<10 m",
	[LESS_THAN_3M] = "<3 m",
	[LESS_THAN_1M] = "<1 m"
};

enum SPEED_ACCURACY {
	UNKNOWN_GREATER_THAN_10M_S = 0, 
	LESS_THAN_10M_S = 1, 
	LESS_THAN_3M_S = 2, 
	LESS_THAN_1M_S = 3, 
	LESS_THAN_0_3M_S = 4
};
static const char* const SPEED_ACCURACY_STRING[] = {
	[UNKNOWN_GREATER_THAN_10M_S] = "UNKNOWN OR >=10 m/s",
	[LESS_THAN_10M_S] = "<10 m/s",
	[LESS_THAN_3M_S] = "<3 m/s",
	[LESS_THAN_1M_S] = "<1 m/s",
	[LESS_THAN_0_3M_S] = "<0.3 m/s"
};

enum SELF_ID_TYPE {
	TEXT_DESCRIPTION = 0, 
	EMERGENCY_DESCRIPTION = 1, 
	EXTENDED_STATUS_DESCRIPTION = 2
};
static const char* const SELF_ID_TYPE_STRING[] = {
	[TEXT_DESCRIPTION] = "TEXT DESCRIPTION",
	[EMERGENCY_DESCRIPTION] = "EMERGENCY DESCRIPTION",
	[EXTENDED_STATUS_DESCRIPTION] = "EXTENDED_STATUS DESCRIPTION"
};

enum OPERATOR_LOCATION_ALTITUDE_SOURCE_TYPE {
	TAKE_OFF = 0, 
	DYNAMIC = 1, 
	FIXED = 2
};
static const char* const OPERATOR_LOCATION_ALTITUDE_SOURCE_TYPE_STRING[] = {
	[TAKE_OFF] = "TAKE OFF",
	[DYNAMIC] = "DYNAMIC",
	[FIXED] = "FIXED"
};

enum UA_CATEGORY {
	UNDEFINED = 0, 
	OPEN = 1, 
	SPECIFIC = 2,
	CERTIFIED = 3
};
static const char* const UA_CATEGORY_STRING[] = {
	[UNDEFINED] = "UNDEFINED",
	[OPEN] = "OPEN",
	[SPECIFIC] = "SPECIFIC",
	[CERTIFIED] = "CERTIFIED"
};

enum UA_CLASS {
	UNDEFINED_CLASS = 0, 
	CLASS0 = 0, 
	CLASS1 = 2,
	CLASS2 = 3,
	CLASS3 = 4,
	CLASS4 = 5,
	CLASS5 = 6,
	CLASS6 = 7,
};
static const char* const UA_CLASS_STRING[] = {
	[UNDEFINED_CLASS] = "UNDEFINED",
	[CLASS0] = "CLASS 0",
	[CLASS1] = "CLASS 1",
	[CLASS2] = "CLASS 2",
	[CLASS3] = "CLASS 3",
	[CLASS4] = "CLASS 4",
	[CLASS5] = "CLASS 5",
	[CLASS6] = "CLASS 6"
};
```
